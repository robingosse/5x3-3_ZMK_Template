/*
 * Robin's Split Keyboard - Left Side
 * SPDX-License-Identifier: MIT
 */

#include "robin_split.dtsi"

&kscan0 {
    // Column pins for LEFT side (6 columns)
    col-gpios
        = <&pro_micro 21 GPIO_ACTIVE_HIGH>
        , <&pro_micro 20 GPIO_ACTIVE_HIGH>
        , <&pro_micro 19 GPIO_ACTIVE_HIGH>
        , <&pro_micro 18 GPIO_ACTIVE_HIGH>
        , <&pro_micro 15 GPIO_ACTIVE_HIGH>
        , <&pro_micro 14 GPIO_ACTIVE_HIGH>
        ;
};
